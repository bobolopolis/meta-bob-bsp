## conf/layer.conf
```bitbake
BBPATH .= ":${LAYERDIR}"
BBFILES += "${LAYERDIR}/recipes-*/*/*.bb ${LAYERDIR}/recipes-*/*/*.bbappend"

BBFILE_COLLECTIONS += "bobbsp"
BBFILE_PATTERN_bobbsp = "^${LAYERDIR}/*"
BBFILE_PRIORITY_bobbsp = "5"

LAYERSERIES_COMPAT_bobbsp = "langdale"
```

## conf/machine/drannit.conf
```bitbake
# Machine configuration for drannit
# Mainboard: Asus E35M1-I Deluxe
# CPU: AMD E-350
# GPU: AMD Radeon HD 6310

require conf/machine/include/x86/tune-btver1.inc

MACHINE_FEATURES = "efi keyboard pci rtc x86"

KERNEL_IMAGETYPE = "bzImage"
PREFERRED_PROVIDER_virtual/kernel ?= "linux-bob"
PREFERRED_VERSION_linux-yocto ?= "5.15%"

# Firmware files actually used:
# * regulatory.db
# * regulatory.db.p7s
# * radeon/PALM_pfp.bin
# * radeon/PALM_me.bin
# * rtl_nic/rtl8168e-2.bin
# * radeon/SUMO_rlc.bin
# * radeon/SUMO_uvd.bin
# * ath3k-1.fw
MACHINE_EXTRA_RRECOMMENDS = " \
    kernel-modules \
    linux-firmware-ath3k \
    linux-firmware-radeon \
    linux-firmware-rtl8168 \
    wireless-regdb-static \
"
```

## conf/machine/fahrbot.conf
```bitbake
# Machine configuration for fahrbot
# Mainboard: 
# CPU: AMD Athlon64 2600+
# GPU: AMD
# Memory: 2 GB

require conf/machine/include/x86/tune-k8-sse3.inc

MACHINE_FEATURES = "keyboard pci rtc x86"

KERNEL_IMAGETYPE = "bzImage"
PREFERRED_PROVIDER_virtual/kernel ?= "linux-bob"
PREFERRED_VERSION_linux-yocto ?= "5.15%"

MACHINE_EXTRA_RRECOMMENDS = "kernel-modules"
```

## conf/machine/include/x86/tune-btver1.inc
```bitbake
# Settings for the GCC cpu-type btver1.
#
# AMD family 14h cores with x86-64 instruction set support. Supported
# extensions include:
#
#   mmx, sse, sse2, sse3, ssse3, sse4a, cx16, abm
#
# This tune is recommended for AMD Bobcat cores

DEFAULTTUNE ?= "btver1-64"

# Include the previous tune to pull in PACKAGE_EXTRA_ARCHS
require conf/machine/include/x86/tune-core2.inc

# Extra tune features
TUNEVALID[btver1] = "Enable btver1 specific processor optimizations"
TUNE_CCARGS .= "${@bb.utils.contains('TUNE_FEATURES', 'btver1', ' -march=btver1', '', d)}"

AVAILTUNES += "btver1-64"
TUNE_FEATURES:tune-btver1-64 = "${TUNE_FEATURES:tune-x86-64} btver1"
BASE_LIB:tune-btver1-64 = "lib64"
TUNE_PKGARCH:tune-btver1-64 = "btver1-64"
PACKAGE_EXTRA_ARCHS:tune-btver1-64 = "${PACKAGE_EXTRA_ARCHS:tune-x86-64} btver1-64"
QEMU_EXTRAOPTIONS_btver1-64 = " -cpu Opteron_G4,check=false"
```

## conf/machine/include/x86/tune-btver2.inc
```bitbake
# Settings for the GCC cpu-type btver2.
#
# AMD family 16h cores with x86-64 instruction set support. Supported
# extensions include:
#
#   mmx, sse, sse2, sse3, ssse3, sse4a, sse4.1, sse4.2, avx, aes, pclmul,
#   f16c, popcnt, abm, bmi, lzcnt, xsave, xsaveopt, movbe
#
# This tune is recommended for AMD Jaguar and Puma cores

DEFAULTTUNE ?= "btver2-64"

# Include the previous tune to pull in PACKAGE_EXTRA_ARCHS
require conf/machine/include/x86/tune-core2.inc

# Extra tune features
TUNEVALID[btver2] = "Enable btver2 specific processor optimizations"
TUNE_CCARGS .= "${@bb.utils.contains('TUNE_FEATURES', 'btver2', ' -march=btver2', '', d)}"

AVAILTUNES += "btver2-64"
TUNE_FEATURES:tune-btver2-64 = "${TUNE_FEATURES:tune-x86-64} btver2"
BASE_LIB:tune-btver2-64 = "lib64"
TUNE_PKGARCH:tune-btver2-64 = "btver2-64"
PACKAGE_EXTRA_ARCHS:tune-btver2-64 = "${PACKAGE_EXTRA_ARCHS:tune-x86-64} btver2-64"
QEMU_EXTRAOPTIONS_btver2-64 = " -cpu phenom,bmi1=on,sse4.1=on,movbe=on"
```

## conf/machine/include/x86/tune-k8-sse3.inc
```bitbake
# Settings for the GCC cpu-type k8-sse3.
#
# AMD K8 cores with x86-64 instruction set support. Supported
# extensions include:
#   3dnow, 3dnowext, mmx, sse, sse2, sse3
#

DEFAULTTUNE ?= "k8-sse3-64"

# Include the previous tune to pull in PACKAGE_EXTRA_ARCHS
require conf/machine/include/x86/tune-core2.inc

# Extra tune features
TUNEVALID[k8-sse3] = "Enable k8-sse3 specific processor optimizations"
TUNE_CCARGS .= "${@bb.utils.contains('TUNE_FEATURES', 'k8-sse3', ' -march=k8-sse3', '', d)}"

AVAILTUNES += "k8-sse3-64"
TUNE_FEATURES:tune-k8-sse3-64 = "${TUNE_FEATURES:tune-x86-64} k8-sse3"
BASE_LIB:tune-k8-sse3-64 = "lib64"
TUNE_PKGARCH:tune-k8-sse3-64 = "k8-sse3-64"
PACKAGE_EXTRA_ARCHS:tune-k8-sse3-64 = "${PACKAGE_EXTRA_ARCHS:tune-x86-64} k8-sse3-64"
QEMU_EXTRAOPTIONS_k8-sse3-64 = " -cpu phenom,check=false"
```

## conf/machine/tralk.conf
```bitbake
# Machine configuration for tralk
# Mainboard: AMD AM1 socket
# CPU: AMD Athlon 5350
# GPU: AMD Radeon R3
# Memory: 8 GB

require conf/machine/include/x86/tune-btver2.inc

MACHINE_FEATURES = "efi keyboard pci rtc x86"

KERNEL_IMAGETYPE = "bzImage"
PREFERRED_PROVIDER_virtual/kernel ?= "linux-bob"
PREFERRED_VERSION_linux-yocto ?= "5.15%"

MACHINE_EXTRA_RRECOMMENDS = "kernel-modules"
```

## scripts/lib/wic/canned-wks/initramfs-only.wks
```
# short-description: Create an EFI disk image with systemd-boot, kernel, and initramfs
# long-description: Creates a partitioned EFI disk image that the user
# can directly dd to boot media. The selected bootloader is systemd-boot. The
# image is contained within just the kernel and initramfs, no root filesystem
# is used.

part /boot --source bootimg-efi --sourceparams="loader=systemd-boot,initrd=amd-uc.img" --ondisk sda --label msdos --active --align 1024 --use-uuid
bootloader --ptable gpt --timeout=5
```
